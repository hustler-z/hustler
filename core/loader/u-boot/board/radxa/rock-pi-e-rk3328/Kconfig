## core/loader/u-boot/board/radxa/rock-pi-e-rk3328/Kconfig
```kconfig
if TARGET_ROCK_PI_E_RK3328

config SYS_BOARD
	default "rock-pi-e-rk3328"

config SYS_VENDOR
	default "radxa"

config SYS_CONFIG_NAME
	default "rock-pi-e-rk3328"

config BOARD_SPECIFIC_OPTIONS # dummy
	def_bool y

endif
```

## rtos/freeRTOS/standalone/drivers/can/Kconfig
```kconfig
config USE_FCAN
    bool
    prompt "Use FCAN"
    default n
    help
        Include FCAN driver component
```

## rtos/freeRTOS/standalone/drivers/media/Kconfig
```kconfig
menu "Media Configuration"

    config ENABLE_FDC_DP_USE_LIB
      bool
      prompt "USE FMEDIA LIB TO LINK"
      
endmenu
```

## rtos/freeRTOS/standalone/drivers/mmc/Kconfig
```kconfig
config ENABLE_FSDMMC
    bool
    prompt "Use FSdmmc"
    default n
    depends on USE_SDMMC
    help
        Select FSdmmc driver component
	
config ENABLE_FSDIF
    bool
    prompt "Use FSdif"
    default n
    depends on USE_SDMMC
    help
        Select FSdif driver component
```

## rtos/freeRTOS/standalone/example/peripherals/gicv3/slave/Kconfig
```kconfig
mainmenu "Phytium Baremetal Configuration"


source "$(SDK_DIR)/standalone.kconfig"
source "src/Kconfig"
```

## rtos/freeRTOS/standalone/example/system/amp/openamp/device_core/Kconfig
```kconfig
#
# For a description of the syntax of this configuration file,
# see tools/kconfiglib/kconfig-language.txt.
#


mainmenu "Phytium Baremetal Configuration"

	menu "Project Configuration"

		menu " Baremetal Configuration"
		config TARGET_NAME
			string "Build Target Name"
			default "opeanamp_core1"
			help
				Build Target name for the demo
	
	endmenu

	
	menu "Amp Config"
		config IPI_IRQ_NUM
			int "Communication interruption number between multiple cores"
			default 0
		
		config IPI_IRQ_NUM_PRIORITY
			int "Priority of internuclear communication interruption"
			default 16
		
		config SPIN_MEM
			hex "Spin-lock shared memory"
			default 0x80000000

		config IPI_CHN_BITMASK
			int "Destination IPI mask"
			default 2
			help
				Each bit represents a CPU, for example, 0x3 represents CPU 0 and CPU 3 in the code.

		if TARGET_D2000
			choice OPENAMP_WORK_MODE
				prompt "Select work mode"
				default WITH_BAREMETAL
				config WITH_BAREMETAL
					bool "Test for baremetal" 
			endchoice # BUILD_TARGET_ARCH_TYPE
		endif

	endmenu
	
endmenu



source "$(SDK_DIR)/standalone.kconfig"
```

## rtos/freertos/example/network/lwip_startup/Kconfig
```kconfig
mainmenu "Phytium FreeRTOS Configuration"
	
source "$(SDK_DIR)/../freertos.kconfig"
```

## rtos/freertos/example/system/exception_debug/Kconfig
```kconfig
mainmenu "Phytium FreeRTOS Configuration"

menu "Project Configuration"

	choice EXCEPTION_TEST_TYPE
        prompt "exception type"
        default EXCEPTION_INVALID_INSTRUCTION
        help
            Select Transfer Mode as Poll or Intrrupt

        config EXCEPTION_INVALID_INSTRUCTION
            bool "Invalid instruction"

		config EXCEPTION_ACCESS_PERMISSION_ERROR
            bool "Memory access permission error"

        config EXCEPTION_ACCESS_VIOLATION
            bool "Memory access violation"

    endchoice #EXCEPTION_TEST_TYPE

endmenu

source "$(SDK_DIR)/../freertos.kconfig"
```

## rtos/freertos/standalone/drivers/i2s/Kconfig
```kconfig
menu "I2S Configuration"
    config USE_ES8336
        bool
        prompt "USE ES8336"
        default n
    
    config USE_FI2S
        bool
        prompt "USE FI2S"
        default n
endmenu
```

## rtos/freertos/standalone/example/peripherals/gicv3/master/src/Kconfig
```kconfig
menu "Master project Configuration"

config SPIN_MEM
	hex "Spin-lock shared memory"
	default 0x80000000

config SHARE_BUFFER_BASE
	hex "Shared buffer base address"
	default 0xc0000000

config SLAVE_CORE_ID
	hex "Slave target core"
	default 1

config MASTER_CORE_ID
	hex "Master target core"
	default 0

config FGIC_SPI_UART_INSTANCE_ADDRESS
	hex "Share buffer address uart address"
	default 0xc1000000  

endmenu
```

## rtos/freertos/standalone/example/peripherals/gicv3/slave/src/Kconfig
```kconfig
menu "Master project Configuration"

config SPIN_MEM
	hex "Spin-lock shared memory"
	default 0x80000000

config SHARE_BUFFER_BASE
	hex "Shared buffer base address"
	default 0xc0000000

config FGIC_SPI_UART_INSTANCE_ADDRESS
	hex "Share buffer address uart address"
	default 0xc1000000  


endmenu
```

## rtos/freertos/standalone/example/system/amp/libmetal_test/rpu_running/Kconfig
```kconfig
#
# For a description of the syntax of this configuration file,
# see tools/kconfiglib/kconfig-language.txt.
#


mainmenu "Phytium Baremetal Configuration"

	menu "Project Configuration"


	config SHM_BASE_ADDR
		hex "Share memory address set"
		default 0xc0000000
				



	menu "AMP Config"

		config IPI_IRQ_NUM
			int "Communication interruption number between multiple cores"
			default 0
		
		config IPI_IRQ_NUM_PRIORITY
			int "Priority of internuclear communication interruption"
			default 16
		
		config SPIN_MEM
			hex "Spin-lock shared memory"
			default 0x80000000

		config TARGET_CPU_ID
			int "Destination CPU communication id"
			default 1

	endmenu
endmenu



source "$(SDK_DIR)/standalone.kconfig"
```

## rtos/freertos/standalone/example/system/amp/openamp/driver_core/Kconfig
```kconfig
#
# For a description of the syntax of this configuration file,
# see tools/kconfiglib/kconfig-language.txt.
#


mainmenu "Phytium Baremetal Configuration"

	menu "Project Configuration"

		menu " Baremetal Configuration"
		config TARGET_NAME
			string "Build Target Name"
			default "openamp_core0"
			help
				Build Target name for the demo

	endmenu


	menu "AMP Config"

		config IPI_IRQ_NUM
			int "Communication interruption number between multiple cores"
			default 0
		
		config IPI_IRQ_NUM_PRIORITY
			int "Priority of internuclear communication interruption"
			default 16
		
		config SPIN_MEM
			hex "Spin-lock shared memory"
			default 0x80000000

		config TARGET_CPU_MASK
			int "Destination CPU id"
			default 1

		config IPI_CHN_BITMASK
			int "Destination IPI cpu mask"
			default 1
			help
				Each bit represents a CPU, for example, 0x3 represents CPU 0 and CPU 3 in the code.
		
		config DEBUG_CODE
			bool
			prompt "use baremetal code for testing"
			default 1
			help
				Debug mode means using two bare metal code to simulate the operation of OpenAMP program
		
	endmenu
	
endmenu



source "$(SDK_DIR)/standalone.kconfig"
```

## rtos/freertos/standalone/third-party/fatfs-0.1.4/port/Kconfig
```kconfig
config FATFS_RAM_DISK
    bool "RAM"
    default y
    help
        Support Fatfs in RAM storage

if FATFS_RAM_DISK
    menu "RAM Disk Configuration"
        config FATFS_RAM_DISK_BASE
            hex "Base address/Hex"
            default 0xa0000000
            help
                Setup start address of RAM Disk

        config FATFS_RAM_DISK_SIZE_MB
            int "Total size/MB"
            default 500
            help
                Setup space size of RAM Disk

        config FATFS_RAM_DISK_SECTOR_SIZE_BYTE
            int "Sector size/B"
            default 512
            help
                Setup sector size of RAM Disk

    endmenu
endif

config FATFS_SDMMC
    bool

config FATFS_SDMMC_FSDIF_TF
    bool "MicroSD(TF)(FSDIF)"
    default n
    select FATFS_SDMMC
    help
        Support Fatfs in SD storage

config FATFS_SDMMC_FSDIF_EMMC
    bool "eMMC(FSDIF)"
    default n
    select FATFS_SDMMC
    help
        Support Fatfs in eMMC storage

if FATFS_SDMMC
    config FATFS_SDMMC_PARTITION
        int "Partition"
        default 0
        default 2 if CONFIG_TARGET_PHYTIUMPI
        help
            Select the partition used of SDMMC storage used in filesystem
endif

config FATFS_SDMMC_FSDMMC_TF
    bool "MicroSD(TF)(FSDMMC)"
    default n
    select FATFS_SDMMC
    help
        Support Fatfs in SD storage

config FATFS_SATA_DISK
    bool "SATA"
    default n
    help
        Support Fatfs in SATA storage

if FATFS_SATA_DISK
    menu "SATA Disk Configuration"
        config FATFS_FSATA
            bool "Sata_controller"
            default n
            select USE_SATA
            select ENABLE_FSATA
            help
            Support Fatfs in Sata_controller storage

        config FATFS_FSATA_PCIE
            bool "Sata_pcie"
            default n
            select USE_PCIE
            select ENABLE_F_PCIE
            select USE_SATA
            select ENABLE_FSATA
            help
            Support Fatfs in Sata_Pcie storage
    endmenu
endif

config FATFS_USB
    bool "USB"
    default n
    help
        Support Fatfs in USB Mass storage
```

## rtos/freertos/standalone/tools/build/new_boot_code/Kconfig
```kconfig
mainmenu "Phytium Baremetal boot Configuration"



source "$(SDK_DIR)/standalone.kconfig"
```
